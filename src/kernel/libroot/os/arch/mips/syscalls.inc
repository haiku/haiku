/* 
** Copyright 2001, Travis Geiselbrecht. All rights reserved.
** Distributed under the terms of the NewOS License.
*/
#define SYSCALL0(name, number) .align 2 ; .globl name ; .type name,@function ; name:
#define SYSCALL1(name, number) .align 2 ; .globl name ; .type name,@function ; name:
#define SYSCALL2(name, number) .align 2 ; .globl name ; .type name,@function ; name:
#define SYSCALL3(name, number) .align 2 ; .globl name ; .type name,@function ; name:
#define SYSCALL4(name, number) .align 2 ; .globl name ; .type name,@function ; name:
#define SYSCALL5(name, number) .align 2 ; .globl name ; .type name,@function ; name:
#define SYSCALL6(name, number) .align 2 ; .globl name ; .type name,@function ; name:
#define SYSCALL7(name, number) .align 2 ; .globl name ; .type name,@function ; name:
#define SYSCALL8(name, number) .align 2 ; .globl name ; .type name,@function ; name:
#define SYSCALL9(name, number) .align 2 ; .globl name ; .type name,@function ; name:
#define SYSCALL10(name, number) .align 2 ; .globl name ; .type name,@function ; name:
#define SYSCALL11(name, number) .align 2 ; .globl name ; .type name,@function ; name:
#define SYSCALL12(name, number) .align 2 ; .globl name ; .type name,@function ; name:
#define SYSCALL13(name, number) .align 2 ; .globl name ; .type name,@function ; name:
#define SYSCALL14(name, number) .align 2 ; .globl name ; .type name,@function ; name:
#define SYSCALL15(name, number) .align 2 ; .globl name ; .type name,@function ; name:
#define SYSCALL16(name, number) .align 2 ; .globl name ; .type name,@function ; name:


